## hardware/beaver/firmware_archive/2026-09-03-source/sdkconfig.defaults
```kconfig
# ESP32-S3 target
CONFIG_IDF_TARGET="esp32s3"
CONFIG_ESP32S3_DEFAULT_CPU_FREQ_240=y

# USB CDC (USB Serial JTAG)
CONFIG_ESP_CONSOLE_USB_SERIAL_JTAG=y
CONFIG_USB_SERIAL_JTAG_RX_BUFFER_SIZE=1024
CONFIG_USB_SERIAL_JTAG_TX_BUFFER_SIZE=4096

# FreeRTOS
CONFIG_FREERTOS_HZ=1000

# Logging
CONFIG_LOG_DEFAULT_LEVEL_INFO=y

# I2C
CONFIG_I2C_TASKS_STACK_SIZE=3072

# Watchdog
CONFIG_ESP_TASK_WDT_TIMEOUT_S=60
CONFIG_ESP_TASK_WDT_CHECK_IDLE_TASK_CPU0=y
CONFIG_ESP_TASK_WDT_CHECK_IDLE_TASK_CPU1=y

# Main task stack (VL53L7CX init needs stack)
CONFIG_ESP_MAIN_TASK_STACK_SIZE=8192
```
